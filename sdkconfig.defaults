## sdkconfig.defaults
```kconfig
CONFIG_IDF_TARGET_ARCH_XTENSA=y
CONFIG_IDF_TARGET_ARCH="xtensa"
CONFIG_IDF_TARGET="esp32"
CONFIG_IDF_INIT_VERSION="5.4.0"
CONFIG_IDF_TARGET_ESP32=y

CONFIG_SPIFFS_OBJ_NAME_LEN=64
CONFIG_PARTITION_TABLE_CUSTOM=y

CONFIG_ESPTOOLPY_FLASHSIZE_4MB=y
CONFIG_ESPTOOLPY_FLASHSIZE="4MB"

CXX_EXCEPTIONS=y
CONFIG_COMPILER_CXX_EXCEPTIONS=y
CONFIG_COMPILER_CXX_EXCEPTIONS_EMG_POOL_SIZE=0

CONFIG_COMPILER_STACK_CHECK=y
```
